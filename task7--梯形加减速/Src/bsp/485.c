#include "stm32f10x.h"
#include <FreeRTOS.h>
#include <task.h>
#include <string.h>
#include "485.h"
#include "timer.h"

static volatile uint8_t  usart1_rx_buffer[256];
static volatile uint16_t usart1_rx_index = 0;
static volatile uint8_t  usart1_rx_finished = 0;
static volatile uint16_t usart1_rx_count = 0;

/* ---------- 4851 串口 USART1  PA9-->TX   PA10-->RX ---------- */
static void Usart1Init(void)
{
	// 使能GPIOC, USART, AFIO
	RCC_APB2PeriphClockCmd(RCC_APB2Periph_USART1, ENABLE);
	RCC_APB2PeriphClockCmd(RCC_APB2Periph_GPIOA, ENABLE);

	// PA9推挽输出 PA10上拉输入 PA12推挽输出
	GPIO_InitTypeDef GPIO_InitStructure;
	GPIO_InitStructure.GPIO_Mode = GPIO_Mode_AF_PP;
	GPIO_InitStructure.GPIO_Pin = GPIO_Pin_9;
	GPIO_InitStructure.GPIO_Speed = GPIO_Speed_50MHz;
	GPIO_Init(GPIOA, &GPIO_InitStructure);
	GPIO_InitStructure.GPIO_Mode = GPIO_Mode_IPU;
	GPIO_InitStructure.GPIO_Pin = GPIO_Pin_10;
	GPIO_InitStructure.GPIO_Speed = GPIO_Speed_50MHz;
	GPIO_Init(GPIOA, &GPIO_InitStructure);
	GPIO_InitStructure.GPIO_Mode = GPIO_Mode_Out_PP;
	GPIO_InitStructure.GPIO_Pin = GPIO_Pin_12;
	GPIO_InitStructure.GPIO_Speed = GPIO_Speed_50MHz;
	GPIO_Init(GPIOA, &GPIO_InitStructure);
	GPIO_ResetBits(GPIOA, GPIO_Pin_12);

	// USART1 9600 - 8 - 1 - 0
	USART_InitTypeDef USART_InitStructure;
	USART_InitStructure.USART_BaudRate = 9600;
	USART_InitStructure.USART_HardwareFlowControl = USART_HardwareFlowControl_None;
	USART_InitStructure.USART_Mode = USART_Mode_Tx | USART_Mode_Rx;
	USART_InitStructure.USART_Parity = USART_Parity_No;
	USART_InitStructure.USART_StopBits = USART_StopBits_1;
	USART_InitStructure.USART_WordLength = USART_WordLength_8b;
	USART_Init(USART1, &USART_InitStructure);

	// 使能中断
	USART_ITConfig(USART1, USART_IT_IDLE, ENABLE);
	USART_ITConfig(USART1, USART_IT_RXNE, ENABLE);

	// NVIC配置
	NVIC_InitTypeDef NVIC_InitStructure;
	NVIC_InitStructure.NVIC_IRQChannel = USART1_IRQn;
	NVIC_InitStructure.NVIC_IRQChannelCmd = ENABLE;
	NVIC_InitStructure.NVIC_IRQChannelPreemptionPriority = 1;
	NVIC_InitStructure.NVIC_IRQChannelSubPriority = 2;
	NVIC_Init(&NVIC_InitStructure);

	// 使能USART1
	USART_Cmd(USART1, ENABLE);
}

// 使用USART1 发送一个字节
static void Serial1SendByte(uint8_t Byte)
{
	USART_SendData(USART1, Byte);

	while (USART_GetFlagStatus(USART1, USART_FLAG_TXE) == RESET)
	{
		;
	}
}

// 使用USART1 发送一个字符串
static void Serial1SendString(char *String)
{
	uint8_t i;

	for (i = 0; String[i] != '\0'; i++)
	{
		Serial1SendByte(String[i]);
	}
}

/* ---------- CRC16 Modbus ---------- */

static const uint8_t s_crchi[] = {
	0x00, 0xC1, 0x81, 0x40, 0x01, 0xC0, 0x80, 0x41, 0x01, 0xC0,
	0x80, 0x41, 0x00, 0xC1, 0x81, 0x40, 0x01, 0xC0, 0x80, 0x41,
	0x00, 0xC1, 0x81, 0x40, 0x00, 0xC1, 0x81, 0x40, 0x01, 0xC0,
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	0x80, 0x41, 0x00, 0xC1, 0x81, 0x40
};

static const uint8_t s_crclo[] = {
	0x00, 0xC0, 0xC1, 0x01, 0xC3, 0x03, 0x02, 0xC2, 0xC6, 0x06,
	0x07, 0xC7, 0x05, 0xC5, 0xC4, 0x04, 0xCC, 0x0C, 0x0D, 0xCD,
	0x0F, 0xCF, 0xCE, 0x0E, 0x0A, 0xCA, 0xCB, 0x0B, 0xC9, 0x09,
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	0x43, 0x83, 0x41, 0x81, 0x80, 0x40
};

static uint16_t Crc16Modbus(uint8_t *_pBuf, uint16_t _usLen)
{
	uint8_t ucCRCHi = 0xFF;
	uint8_t ucCRCLo = 0xFF;
	uint16_t usIndex;

	while (_usLen--)
	{
		usIndex = ucCRCHi ^ *_pBuf++;
		ucCRCHi = ucCRCLo ^ s_crchi[usIndex];
		ucCRCLo = s_crclo[usIndex];
	}
	return ((uint16_t)ucCRCHi << 8 | ucCRCLo);
}

// 485的初始化
void Rs485Init(void)
{
	Usart1Init();
}

// 485发送字符串
void Rs485UartWrite(char* String)
{
	uint8_t i = 0;

	// 485 设置为发送
	GPIO_SetBits(GPIOA, GPIO_Pin_12);
	vTaskDelay(3);

	for (i = 0; String[i] != '\0'; i++)
	{
		Serial1SendByte(String[i]);
	}

	vTaskDelay(3);
	// 485 设置为接收
	GPIO_ResetBits(GPIOA, GPIO_Pin_12);
}

// 使用485发送指令
void Rs485TxOpr(uint8_t uAddr, uint8_t opr, uint16_t uReg, uint16_t uData)
{
	uint8_t  tx_date[8];
	uint16_t crc;

	tx_date[0] = uAddr;
	tx_date[1] = opr;
	tx_date[2] = uReg >> 8;
	tx_date[3] = uReg;
	tx_date[4] = uData >> 8;
	tx_date[5] = uData;

	// CRC校验
	crc = Crc16Modbus(tx_date, 6);
	tx_date[6] = crc >> 8;
	tx_date[7] = crc & 0xFF;

	// 485 设置为发送
	GPIO_SetBits(GPIOA, GPIO_Pin_12);
	vTaskDelay(3);

	for (uint8_t i = 0; i < 8; i++)
	{
		Serial1SendByte(tx_date[i]);
	}

	vTaskDelay(3);
	// 485 设置为接收
	GPIO_ResetBits(GPIOA, GPIO_Pin_12);
}

// 485接收数据 + 校验
static uint32_t Rs485RxData(void)
{
	uint32_t result = 0;

	if (usart1_rx_finished)
	{
		usart1_rx_finished = 0;

		if (usart1_rx_count > 5)
		{
			// 校验CRC
			uint16_t crc_calc = Crc16Modbus((uint8_t*)usart1_rx_buffer, usart1_rx_count - 2);
			uint16_t crc_recv = (usart1_rx_buffer[usart1_rx_count - 2] << 8) | usart1_rx_buffer[usart1_rx_count - 1];

			if (crc_calc == crc_recv)
			{
				result = (usart1_rx_buffer[3] << 8) | usart1_rx_buffer[4];
			}
		}
		// 清空接收缓冲区
		memset((void*)usart1_rx_buffer, 0, usart1_rx_count);
		usart1_rx_count = 0;
	}
	return result;
}

// 获取温度值
uint32_t GetTempture(void)
{
	Rs485TxOpr(0x12, 0x03, 0x0102, 0x0001);
	vTaskDelay(100);

	if (usart1_rx_finished)
	{
		float temp = (float)Rs485RxData() / 10;
		return (uint32_t)temp;
	}
	else
	{
		return 0xFFFFFFFF;
	}
}

// 获取距离值
uint32_t GetDistance(void)
{
	Rs485TxOpr(0x12, 0x03, 0x0101, 0x0001);
	vTaskDelay(100);

	if (usart1_rx_finished)
	{
		float dis = (float)Rs485RxData();
		return (uint32_t)dis;
	}
	else
	{
		return 0xFFFFFFFF;
	}
}

// USART1中断接收处理函数
void USART1_IRQHandler(void)
{
	if (USART_GetITStatus(USART1, USART_IT_RXNE) != RESET)
	{
		uint8_t data = USART_ReceiveData(USART1);

		if (usart1_rx_index < 256)
		{
			usart1_rx_buffer[usart1_rx_index++] = data;
		}
		USART_ClearITPendingBit(USART1, USART_IT_RXNE);
	}

	if (USART_GetITStatus(USART1, USART_IT_IDLE) != RESET)
	{
		volatile uint16_t temp = USART1->SR;
		temp = USART1->DR;
		(void)temp;

		usart1_rx_count = usart1_rx_index;
		usart1_rx_finished = 1;
		usart1_rx_index = 0;
		USART_ClearITPendingBit(USART1, USART_IT_IDLE);
	}
}
